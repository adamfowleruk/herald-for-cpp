## CMakeLists.txt
```
# Copyright 2020-2022 Herald Project Contributors
# SPDX-License-Identifier: Apache-2.0

set(CMAKE_VERBOSE_MAKEFILE ON)

set(CMAKE_CXX_STANDARD 17)
set(CMAKE_CXX_STANDARD_REQUIRED ON)
set(CMAKE_CXX_EXTENSIONS ON)

set(NO_BUILD_TYPE_WARNING ON)


# Zephyr build environment variables set here
#set(ENV{BOARD} nrf52840dongle_nrf52840) # nRF52840 USB dongle
#set(ENV{BOARD} nrf52dk_nrf52832) # nRF52832 USB dongle
#set(ENV{BOARD} nrf52833dk_nrf52833) # nRF52833 DK
#set(ENV{BOARD} nrf5340dk_nrf5340_cpuapp) # nRF5340 DK using secure app core
# Detect if already set. If not, default to latest nRF DK board (5340)
if(DEFINED ENV{BOARD})
  message("Using board specified in BOARD variable: $ENV{BOARD}")
else()
  message("No board specified in BOARD variable. Defaulting to nrf5340dk app core")
  set(ENV{BOARD} nrf5340dk_nrf5340_cpuapp) # nRF5340 DK using secure app core
  set(ENV{ARCH} arm)
  message("BOARD variable now set to: $ENV{BOARD}")
endif()

# Specify additional PROJ settings based on build settings
# set(BASE_CONFIG ../config/zephyr)
# set(OVERLAY_CONFIG
#   ${BASE_CONFIG}/base-mesh.conf
#   ${BASE_CONFIG}/usb.conf
#   # ${BASE_CONFIG}/receiver.conf
#   # ${BASE_CONFIG}/transmitter.conf
# )

# if($ENV{BOARD} MATCHES .*nrf5340.*)
#   set(OVERLAY_CONFIG 
#     ${OVERLAY_CONFIG} 
#     ${BASE_CONFIG}/nrf5340.conf
#   )
#   add_definitions(-DHERALD_MEMORYARENA_MAX=4096)
# elseif($ENV{BOARD} MATCHES .*nrf52840.*)
#   set(OVERLAY_CONFIG 
#     ${OVERLAY_CONFIG} 
#     ${BASE_CONFIG}/nrf52840.conf
#   )
#   add_definitions(-DHERALD_MEMORYARENA_MAX=4096)
# elseif($ENV{BOARD} MATCHES .*nrf52832.*)
#   set(OVERLAY_CONFIG 
#     ${OVERLAY_CONFIG} 
#     ${BASE_CONFIG}/nrf52832.conf
#   )
#   add_definitions(-DHERALD_MEMORYARENA_MAX=512)
# elseif($ENV{BOARD} MATCHES .*nrf52833.*)
#   set(OVERLAY_CONFIG 
#     ${OVERLAY_CONFIG} 
#     ${BASE_CONFIG}/nrf52833.conf
#   )
#   add_definitions(-DHERALD_MEMORYARENA_MAX=4096)
# endif()
# if(CMAKE_BUILD_TYPE MATCHES Debug)
#   set(OVERLAY_CONFIG 
#     ${OVERLAY_CONFIG} 
#     ${BASE_CONFIG}/debug.conf
#   )
# else()
#   set(OVERLAY_CONFIG 
#     ${OVERLAY_CONFIG} 
#     ${BASE_CONFIG}/release.conf
#   )
# endif()


# Generic Zephyr build command below
cmake_minimum_required(VERSION 3.13.1)
find_package(Zephyr REQUIRED HINTS $ENV{ZEPHYR_BASE})
project(herald-mesh-modem VERSION 2.1.0 LANGUAGES CXX)

# NOTE: Don't include C library as it bloats the binary beyond DFU max load size (i.e. beyond half of the available flash)

set(HERALD_TARGET zephyr)


# WARNING DO NOT USE THE ZEPHYR DEFAULT EXTERNAL PROJECT INCLUDE METHOD
# IT DOES NOT PROVIDE ZEPHYR BUILD SETTINGS CORRECTLY WHEN CROSS COMPILING ON WINDOWS


# Include Herald core library
set(HERALD_BASE ${CMAKE_CURRENT_SOURCE_DIR}/../herald)
include(../herald/herald.cmake) # include sources and headers

message("HERALD HEADERS: ${HERALD_HEADERS}")

include_directories(../herald/include)

if(CMAKE_BUILD_TYPE MATCHES Debug)
  add_definitions(-DHERALD_LOG_LEVEL=4 -DCONFIG_APP_LOG_LEVEL=4)
else()
  add_definitions(-DHERALD_LOG_LEVEL=0 -DCONFIG_APP_LOG_LEVEL=0)
endif()
#HERALD_LOG_LEVEL 4 = debug, 3 = info, 2 = warn / errors (Zephyr LOG_WARN), 1 = info contacts log only (Zephyr LOG_ERR)

# gcc arm does not warn about missing defs until runtime
# add_compile_options(--no-undefined -ffunction-sections -fdata-sections -s -fno-unaligned-access -fno-exceptions -fno-rtti -Wall -Wextra -Wl,-z,defs,norelro,--strict,--strict_symbols,--gc-sections,--hash-style=gnu)

message("HERALD SOURCES MESH: ${HERALD_SOURCES_MESH}")
target_sources(app PRIVATE
  # ${HERALD_SOURCES}
  # ${HERALD_SOURCES_ZEPHYR}
  # ${HERALD_SOURCES_TINYCRYPT}
  # #${HERALD_SOURCES_MBEDTLS}
  # ${HERALD_SOURCES_MESH}
  ../herald/src/mesh/modem.c
  src/main.cpp
)
target_include_directories(app PRIVATE include)
```

## prj.conf
```kconfig
CONFIG_USB_CDC_ACM=y
#CONFIG_RING_BUFFER=y
# ^^^ Implied by the first line
CONFIG_USB_DEVICE_VID=0x8086
CONFIG_USB_DEVICE_PID=0x0001
CONFIG_STDOUT_CONSOLE=y
CONFIG_USB_DEVICE_STACK=y
CONFIG_USB_DEVICE_PRODUCT="Herald MESH Modem"
CONFIG_LOG=y
CONFIG_USB_DRIVER_LOG_LEVEL_ERR=y
CONFIG_USB_DEVICE_LOG_LEVEL_ERR=y
CONFIG_SERIAL=y
CONFIG_UART_INTERRUPT_DRIVEN=y
CONFIG_UART_LINE_CTRL=y





# CONFIG_BT_DEVICE_NAME="Herald MESH Modem"

# CONFIG_GPIO=y



# # FROM MESH NEEDS

# # General configuration
# CONFIG_SYSTEM_WORKQUEUE_STACK_SIZE=2048
# CONFIG_FLASH=y
# CONFIG_FLASH_MAP=y
# CONFIG_NVS=y
# # Below required for BT_SETTINGS
# CONFIG_SETTINGS=y
# CONFIG_HWINFO=y
# CONFIG_DK_LIBRARY=y

# # Bluetooth configuration
# CONFIG_BT=y
# # Use Linux Foundation code
# CONFIG_BT_COMPANY_ID=0x0059
# #CONFIG_BT_DEVICE_NAME="Mesh and Peripheral Coex"
# CONFIG_BT_L2CAP_TX_MTU=69
# CONFIG_BT_L2CAP_TX_BUF_COUNT=8
# CONFIG_BT_OBSERVER=y
# CONFIG_BT_PERIPHERAL=y
# CONFIG_BT_SETTINGS=y

# CONFIG_BT_EXT_ADV=y
# # This defaults to 1!
# CONFIG_BT_EXT_ADV_MAX_ADV_SET=5
# # CONFIG_BT_EXT_ADV_MAX_ADV_SET=2
# CONFIG_BT_MAX_CONN=3

# # Disable unused Bluetooth features
# CONFIG_BT_CTLR_DUP_FILTER_LEN=0
# CONFIG_BT_CTLR_LE_ENC=n
# CONFIG_BT_DATA_LEN_UPDATE=n
# CONFIG_BT_PHY_UPDATE=n
# CONFIG_BT_CTLR_CHAN_SEL_2=n
# CONFIG_BT_CTLR_MIN_USED_CHAN=n
# CONFIG_BT_CTLR_PRIVACY=n

# # Use the BLE 5.0 2M phy for more ADV_EXT throughput
# # TODO verify it's actually being used
# CONFIG_BT_CTLR_PHY_2M=y

# # Bluetooth mesh configuration
# CONFIG_BT_MESH=y
# CONFIG_BT_MESH_RELAY=y
# CONFIG_BT_MESH_FRIEND=y
# CONFIG_BT_MESH_ADV_BUF_COUNT=13
# CONFIG_BT_MESH_TX_SEG_MAX=10
# CONFIG_BT_MESH_PB_GATT=y
# # The following is needed to set mesh model and publishing config from a phone
# CONFIG_BT_MESH_GATT_PROXY=y

# # TODO replace the below with a Herald NFC provisioner instead
# CONFIG_BT_MESH_DK_PROV=y

# # The following is separate from BT_EXT_ADV
# CONFIG_BT_MESH_ADV_EXT=y

# # Bluetooth mesh models
# CONFIG_BT_MESH_ONOFF_SRV=y

# # Enable the LBS service
# CONFIG_BT_LBS=n
# CONFIG_BT_LBS_POLL_BUTTON=n

# # CONFIG_USE_SEGGER_RTT=y
# CONFIG_RTT_CONSOLE=y
# CONFIG_UART_CONSOLE=n

# # DEBUG ONLY - Allows resetting of provisioning state via RTT (mesh reset)
# # CONFIG_BT_MESH_SHELL=y
# # CONFIG_SHELL_BACKEND_RTT=y

# CONFIG_BT_DEBUG_LOG=y
# CONFIG_BT_MESH_DEBUG=y
# CONFIG_BT_MESH_DEBUG_MODEL=y
# CONFIG_BT_MESH_DEBUG_ACCESS=y
# CONFIG_BT_MESH_DEBUG_MODEL=y
# CONFIG_BT_MESH_DEBUG_TRANS=n
# CONFIG_BT_MESH_DEBUG_NET=n
# CONFIG_BT_MESH_DEBUG_CRYPTO=n
# CONFIG_BT_MESH_DEBUG_ADV=y


# # For issues with advertising failing:-
# # CONFIG_BT_DEBUG_HCI_DRIVER=y
# # CONFIG_BT_DEBUG_HCI_CORE=y
# CONFIG_BT_DEBUG_CONN=y
```

## app.overlay
```dts
/*
 * Copyright (c) 2021 Nordic Semiconductor ASA
 *
 * SPDX-License-Identifier: Apache-2.0
 */

// &zephyr_udc0 {
// 	cdc_acm_uart0 {
// 		compatible = "zephyr,cdc-acm-uart";
// 		label = "CDC_ACM_0";
// 	};
// };

// Newer Zephyr versions:-
&usbd {
	cdc_acm_uart0: cdc_acm_uart0 {
		compatible = "zephyr,cdc-acm-uart";
		label = "CDC_ACM_0";
	};
};
```

## src/main.cpp
```c
/*
 * Copyright (c) 2019 Intel Corporation
 *
 * SPDX-License-Identifier: Apache-2.0
 */

/**
 * @file
 * @brief Sample echo app for CDC ACM class
 *
 * Sample app for USB CDC ACM class driver. The received data is echoed back
 * to the serial port.
 */

#include "herald/mesh/modem.h"

#include <drivers/uart.h>

#include <sys/ring_buffer.h>
#include <usb/usb_device.h>

#include <device.h>
#include <stdio.h>
#include <string.h>
#include <zephyr.h>

#include <logging/log.h>
LOG_MODULE_REGISTER(cdc_acm_echo, LOG_LEVEL_INF);

#define RING_BUF_SIZE 1024
uint8_t ring_buffer_command[RING_BUF_SIZE];
uint8_t ring_buffer_response[RING_BUF_SIZE];

struct ring_buf command_buffer;
struct ring_buf response_buffer;

uint8_t hi[6] = {
  0x00,0x00, // hello
  0x00,0x01, // command id = 0x0001
  0xff,0xff  // boundary
};

static void interrupt_handler(const struct device* dev, void* user_data) {
  ARG_UNUSED(user_data);

  while (uart_irq_update(dev) && uart_irq_is_pending(dev)) {
    if (uart_irq_rx_ready(dev)) {
      int recv_len, rb_len;
      uint8_t buffer[64];
      size_t len = MIN(ring_buf_space_get(&command_buffer), sizeof(buffer));

      recv_len = uart_fifo_read(dev, buffer, len);
      if (recv_len < 0) {
        LOG_ERR("Failed to read UART FIFO");
        recv_len = 0;
      };

      rb_len = ring_buf_put(&command_buffer, buffer, recv_len);
      if (rb_len < recv_len) {
        LOG_ERR("Drop %u bytes", recv_len - rb_len);
      }

      LOG_DBG("tty fifo -> ringbuf %d bytes", rb_len);
      if (rb_len) {
        uart_irq_tx_enable(dev);
      }
    }

    if (uart_irq_tx_ready(dev)) {
      uint8_t buffer[64];
      int rb_len, send_len;

      rb_len = ring_buf_get(&response_buffer, buffer, sizeof(buffer));
      if (!rb_len) {
        LOG_DBG("Ring buffer empty, disable TX IRQ");
        uart_irq_tx_disable(dev);
        continue;
      }

      send_len = uart_fifo_fill(dev, buffer, rb_len);
      if (send_len < rb_len) {
        LOG_ERR("Drop %d bytes", rb_len - send_len);
      }

      LOG_DBG("ringbuf -> tty fifo %d bytes", send_len);
    }
  }
}

void main(void) {
  const struct device* dev;
  uint32_t baudrate, dtr = 0U;
  int ret;

  dev = DEVICE_DT_GET_ONE(zephyr_cdc_acm_uart);
  if (!device_is_ready(dev)) {
    LOG_ERR("CDC ACM device not ready");
    return;
  }

  ret = usb_enable(NULL);
  if (ret != 0) {
    LOG_ERR("Failed to enable USB");
    return;
  }

  ring_buf_init(&command_buffer, sizeof(ring_buffer_command),
                ring_buffer_command);
  ring_buf_init(&response_buffer, sizeof(ring_buffer_response),
                ring_buffer_response);

  LOG_INF("Wait for DTR");

  while (true) {
    uart_line_ctrl_get(dev, UART_LINE_CTRL_DTR, &dtr);
    if (dtr) {
      break;
    } else {
      /* Give CPU resources to low priority threads. */
      k_sleep(K_MSEC(100));
    }
  }

  LOG_INF("DTR set");

  /* They are optional, we use them to test the interrupt endpoint */
  ret = uart_line_ctrl_set(dev, UART_LINE_CTRL_DCD, 1);
  if (ret) {
    LOG_WRN("Failed to set DCD, ret code %d", ret);
  }

  ret = uart_line_ctrl_set(dev, UART_LINE_CTRL_DSR, 1);
  if (ret) {
    LOG_WRN("Failed to set DSR, ret code %d", ret);
  }

  /* Wait 1 sec for the host to do all settings */
  k_busy_wait(1000000);

  ret = uart_line_ctrl_get(dev, UART_LINE_CTRL_BAUD_RATE, &baudrate);
  if (ret) {
    LOG_WRN("Failed to get baudrate, ret code %d", ret);
  } else {
    LOG_INF("Baudrate detected: %d", baudrate);
  }

  uart_irq_callback_set(dev, interrupt_handler);

  /* Enable rx interrupts */
  uart_irq_rx_enable(dev);

  // write dummy hello command to command bugger
  ring_buf_put(&command_buffer, hi, 6);
  ring_buf_put_finish(&command_buffer, 6);

  int cres;
  while (true) {
    LOG_DBG("Main thread still running");
    cres = bt_mesh_modem_process_commands(&command_buffer,&response_buffer);
    if (0 != cres) {
      LOG_ERR("Error in command processing %d",cres);
    }

    /* Give CPU resources to low priority threads. */
    k_sleep(K_MSEC(1000));
  }
}
```
