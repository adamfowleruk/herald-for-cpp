## CMakeLists.txt
```
# SPDX-License-Identifier: Apache-2.0

set(CMAKE_VERBOSE_MAKEFILE ON)

set(CMAKE_CXX_STANDARD 17)
set(CMAKE_CXX_STANDARD_REQUIRED ON)

set(NO_BUILD_TYPE_WARNING ON)

# Zephyr build environment variables set here
#set(ENV{BOARD} nrf52840dongle_nrf52840) # nRF52840 USB dongle
#set(ENV{BOARD} nrf52dk_nrf52832) # nRF52832 USB dongle
#set(ENV{BOARD} nrf52833dk_nrf52833) # nRF52833 DK
#set(ENV{BOARD} nrf5340dk_nrf5340_cpuapp) # nRF5340 DK using secure app core
# Detect if already set. If not, default to latest nRF DK board (5340)
if(DEFINED ENV{BOARD})
  message("Using board specified in BOARD variable: $ENV{BOARD}")
else()
  message("No board specified in BOARD variable. Defaulting to nrf5340dk app core")
  set(ENV{BOARD} nrf5340dk_nrf5340_cpuapp) # nRF5340 DK using secure app core
  set(ENV{ARCH} arm)
  message("BOARD variable now set to: $ENV{BOARD}")
endif()

# Specify additional PROJ settings based on build settings
set(BASE_CONFIG ../config/zephyr)
set(OVERLAY_CONFIG
  ${BASE_CONFIG}/base.conf
  ${BASE_CONFIG}/transmitter.conf
)
# Note: No receiver.conf in this project

if($ENV{BOARD} MATCHES .*nrf5340.*)
  set(OVERLAY_CONFIG 
    ${OVERLAY_CONFIG} 
    ${BASE_CONFIG}/nrf5340.conf
  )
elseif($ENV{BOARD} MATCHES .*nrf52840.*)
  set(OVERLAY_CONFIG 
    ${OVERLAY_CONFIG} 
    ${BASE_CONFIG}/nrf52840.conf
  )
  add_definitions(-DHERALD_MEMORYARENA_MAX=4096)
elseif($ENV{BOARD} MATCHES .*nrf52832.*)
  set(OVERLAY_CONFIG 
    ${OVERLAY_CONFIG} 
    ${BASE_CONFIG}/nrf52832.conf
  )
  add_definitions(-DHERALD_MEMORYARENA_MAX=4096)
elseif($ENV{BOARD} MATCHES .*nrf52833.*)
  set(OVERLAY_CONFIG 
    ${OVERLAY_CONFIG} 
    ${BASE_CONFIG}/nrf52833.conf
  )
endif()
if(CMAKE_BUILD_TYPE MATCHES Debug)
  set(OVERLAY_CONFIG 
    ${OVERLAY_CONFIG} 
    ${BASE_CONFIG}/debug.conf
  )
else()
  set(OVERLAY_CONFIG 
    ${OVERLAY_CONFIG} 
    ${BASE_CONFIG}/release.conf
  )
endif()

# Generic Zephyr build command below
cmake_minimum_required(VERSION 3.13.1)
find_package(Zephyr REQUIRED HINTS $ENV{ZEPHYR_BASE})
project(herald-mesh-relay VERSION 1.2.0 LANGUAGES CXX)
# NOTE: Don't include C library as it bloats the binary beyond DFU max load size (i.e. beyond half of the available flash)

set(HERALD_TARGET zephyr)

# WARNING DO NOT USE THE ZEPHYR DEFAULT EXTERNAL PROJECT INCLUDE METHOD
# IT DOES NOT PROVIDE ZEPHYR BUILD SETTINGS CORRECTLY WHEN CROSS COMPILING ON WINDOWS

set(HERALD_BASE ${CMAKE_CURRENT_SOURCE_DIR}/../herald)
include(../herald/herald.cmake) # include sources and headers

message("HERALD HEADERS: ${HERALD_HEADERS}")

include_directories(../herald/include)

if(CMAKE_BUILD_TYPE MATCHES Debug)
  add_definitions(-DHERALD_LOG_LEVEL=4 -DCONFIG_APP_LOG_LEVEL=4)
else()
  add_definitions(-DCONFIG_APP_LOG_LEVEL=1)
endif()
#HERALD_LOG_LEVEL 4 = debug, 3 = info, 2 = warn / errors (Zephyr LOG_WARN), 1 = info contacts log only (Zephyr LOG_ERR)

# gcc arm does not warn about missing defs until runtime
add_compile_options(--no-undefined -ffunction-sections -fdata-sections -s -fno-exception -fno-rtti -Wall -Wextra -Wno-dev -Wl,-z,defs,norelro,--strict,--strict_symbols,--gc-sections,--hash-style=gnu)


target_sources(app PRIVATE
  ${HERALD_SOURCES}
  ${HERALD_SOURCES_ZEPHYR}
  src/main.cpp
)
```

## Kconfig
```
# menu "Application"

# config APP_FOO
#     bool "Enable bar"
#     default y

# endmenu


menu "Herald"
rsource "../herald/Kconfig.herald"
endmenu

menu "Zephyr Kernel"
source "Kconfig.zephyr"
endmenu
```

## prj.conf
```kconfig
# Herald Mesh Relay Beacon project specific settings
CONFIG_BT_DEVICE_NAME="Herald Mesh Relay"

CONFIG_EXCEPTIONS=n
# CONFIG_HW_STACK_PROTECTION=y

# For all other settings, see ../config/zephyr/base.conf et al

CONFIG_MAIN_STACK_SIZE=4096
CONFIG_SYSTEM_WORKQUEUE_STACK_SIZE=2048
# CONFIG_ISR_STACK_SIZE=8192

# Force strict thread stack protection - costs 27 KB SRAM on nRF52840
# BREAKS stack with MPU FAULT data access violation on Herald thread entry
# CONFIG_USERSPACE=y

# Force halt on asserts
CONFIG_ASSERT=y
CONFIG_ASSERT_LEVEL=2

# Allow easier finding of errors in demo apps
# CONFIG_RESET_ON_FATAL_ERROR=n

# DO NOT ENABLE THIS EVER - Breaks the stack
# CONFIG_NO_OPTIMIZATIONS=y

# REQUIRED for bluetooth serial debug
# CONFIG_BT_NUS=y

# Used for LED
CONFIG_GPIO=y

# For FLASH config storage
CONFIG_FLASH=y
CONFIG_FLASH_MAP=y

# For other warnings
CONFIG_HWINFO=y
CONFIG_BT=y

# HERALD MESH SETTINGS - Also selects V2 protocol see ../herald/Kconfig
CONFIG_HERALD_MESH=y
```

## src/main.cpp
```c
/*
 * SPDX-License-Identifier: Apache-2.0
 */

#include "../../herald/herald.h"

#include <zephyr/types.h>
#include <stddef.h>
#include <string.h>
#include <errno.h>
#include <zephyr/sys/printk.h>
#include <zephyr/sys/byteorder.h>
#include <zephyr/kernel.h>

#include <zephyr/settings/settings.h>

#include <zephyr/bluetooth/bluetooth.h>
#include <zephyr/bluetooth/hci.h>
#include <zephyr/bluetooth/conn.h>
#include <zephyr/bluetooth/uuid.h>
#include <zephyr/bluetooth/gatt.h>
#include <zephyr/bluetooth/services/bas.h>

#include <zephyr/kernel_structs.h>
// #include <sys/thread_stack.h>
#include <zephyr/drivers/gpio.h>
#include <zephyr/drivers/hwinfo.h>

#include <inttypes.h>

#include <zephyr/logging/log.h>

#include <zephyr/storage/flash_map.h>

LOG_MODULE_REGISTER(app, CONFIG_APP_LOG_LEVEL);
#define APP_DBG(_msg,...) LOG_DBG(_msg,##__VA_ARGS__);
#define APP_INF(_msg,...) LOG_INF(_msg,##__VA_ARGS__);
#define APP_ERR(_msg,...) LOG_ERR(_msg,##__VA_ARGS__);

/* 1000 msec = 1 sec */
#define SLEEP_TIME_MS   1000

/* The devicetree node identifier for the "led0" alias. */
#define LED0_NODE DT_ALIAS(led0)
static const struct gpio_dt_spec led = GPIO_DT_SPEC_GET(LED0_NODE, gpios);

/* The maximum name length allowed in Flash storage */
#define MAX_NAME_LENGTH 40

// The below fails with nRF SDK 2.6.1 as its defined in an nrf log include - so we leave commented out now
// void k_sys_fatal_error_handler(unsigned int reason, const z_arch_esf_t *esf) {
// 	// LOG_PANIC();
// 	while (1) {
// 		// do nothing
// 	}
// }

struct k_thread herald_thread;
constexpr int stackMaxSize = 
#ifdef CONFIG_BT_MAX_CONN
	2048 + (CONFIG_BT_MAX_CONN * 512)
	// Was 12288 + (CONFIG_BT_MAX_CONN * 512), but this starved newlibc of HEAP (used in handling BLE connections/devices)
#else
	9192
#endif
// Since v2.1 - MEMORY ARENA extra stack reservation - See herald/datatype/data.h
#ifdef HERALD_MEMORYARENA_MAX
  + HERALD_MEMORYARENA_MAX
#else
  + 8192
#endif
;
K_THREAD_STACK_DEFINE(herald_stack, 
	stackMaxSize
); // Was 9192 for nRF5340 (10 conns), 2048 for nRF52832 (3 conns)


struct DummyDelegate {};

using MYUINT32 = unsigned long;

struct basic_venue {
	std::uint16_t country;
	std::uint16_t state;
	MYUINT32 code; // C++ linker may balk, confusing unsigned int with unsigned long
	std::string name;
};

// static struct basic_venue joesPizza = {
// 	.country = 826,
// 	.state = 4,
// 	.code = 12345,
// 	.name = "Joe's Pizza"
// };

// static struct basic_venue adamsFishShop = {
// 	.country = 826,
// 	.state = 3,
// 	.code = 22334,
// 	.name = "Adam's Fish Shop"
// };

// static struct basic_venue maxsFineDining = {
// 	.country = 832,
// 	.state = 1,
// 	.code = 55566,
// 	.name = "Max's Fine Dining"
// };

// static struct basic_venue erinsStakehouse = {
// 	.country = 826,
// 	.state = 4,
// 	.code = 123123,
// 	.name = "Erin's Stakehouse"
// };

// TODO replace the below with sub-venue extended data, with same venue code
// static struct basic_venue adamsKitchen = {
//   .country = 826,
// 	.state = 4,
// 	.code = 1234,
// 	.name = "Adam's Kitchen"
// };
// static struct basic_venue adamsOffice = {
//   .country = 826,
// 	.state = 4,
// 	.code = 2345,
// 	.name = "Adam's Office"
// };
// static struct basic_venue adamsBedroom = {
//   .country = 826,
// 	.state = 4,
// 	.code = 3456,
// 	.name = "Adam's Bedroom"
// };
// static struct basic_venue adamsLanding = {
//   .country = 826,
// 	.state = 4,
// 	.code = 5678,
// 	.name = "Adam's Landing"
// };
// static struct basic_venue adamsPond = {
//   .country = 826,
// 	.state = 4,
// 	.code = 6789,
// 	.name = "Adam's Pond"
// };
// static struct basic_venue adamsLounge = {
//   .country = 826,
// 	.state = 4,
// 	.code = 7890,
// 	.name = "Adam's Lounge"
// };

// static struct basic_venue estimoteGarage = {
//   .country = 826,
// 	.state = 4,
// 	.code = 666,
// 	.name = "Estimote Herald"
// };

// static struct basic_venue beaconBasic1 = {
//   .country = 1,
// 	.state = 1,
// 	.code = 1,
// 	.name = "Herald-01"
// };
// static struct basic_venue beaconBasic2 = {
//   .country = 2,
// 	.state = 2,
// 	.code = 2,
// 	.name = "Herald-02"
// };
// static struct basic_venue beaconBasic3 = {
//   .country = 3,
// 	.state = 3,
// 	.code = 3,
// 	.name = "Herald-03"
// };
// static struct basic_venue beaconBasic4 = {
//   .country = 4,
// 	.state = 4,
// 	.code = 4,
// 	.name = "Herald-04"
// };

// A Herald Mesh Beacon will advertise just like a Herald Venue Beacon, but with a name becoming the Mesh Node ID

static struct basic_venue noVenue = {
    .country = 0,
	.state = 0,
	.code = 0,
	.name = "UnconfiguredHeraldMeshRelay"
};

void herald_entry() {
	APP_DBG("Herald entry");
	k_sleep(K_MSEC(10000)); // pause so we have time to see Herald initialisation log messages. Don't do this in production!
	APP_DBG("Herald setup begins");

	using namespace herald;
	using namespace herald::payload;
	using namespace herald::payload::beacon;
	using namespace herald::payload::extended;

	// Create Herald sensor array
	ZephyrContextProvider zcp;
	Context ctx(zcp,zcp.getLoggingSink(),zcp.getBluetoothStateManager());
	// using CT = Context<ZephyrContextProvider,ZephyrLoggingSink,BluetoothStateManager>;
	
	// Disable receiver / scanning mode - we're just transmitting our value
	BLESensorConfiguration config = ctx.getSensorConfiguration(); // copy ctor
    // config.heraldProtocolV2Enabled = true; // Enable Herald V2 mesh underlying protocol
    // config.heraldMeshEnabled true; // Enable the mesh
    // The above two are set via Kconfig now. See bottom of ../prj.conf for details
	config.scanningEnabled = true; // Required to find other mesh devices
	// config.advertisingEnabled = true; // default
	ctx.setSensorConfiguration(config);

	// Sun 02 July 2023 - ADDED DYNAMIC BEACON CONFIGURATION FROM FLASH STORAGE
	// Attempt to read Beacon configuration from raw flash
	// If it works, use that for our beacon information
	// If it fails, default to an empty configuration
	std::uint16_t country = noVenue.country;
	std::uint16_t state = noVenue.state;
	std::uint32_t code = noVenue.code;

    // TODO lon lat for Mesh Relay BUT only over encrypted channel, not in advertisement (TBD)

	// X, Y, Z positions in CM from a common origin
	std::uint16_t x = 0;
	std::uint16_t y = 0;
	std::uint16_t z = 0;
	std::string name = std::string(noVenue.name); // force copy

	const struct flash_area *storageArea;
	int err = flash_area_open(FIXED_PARTITION_ID(storage_partition), &storageArea);

	if (err < 0) {
		APP_DBG("Error opening storage flash area");
	} else {
		APP_DBG("Attempting to read flash storage...");
		// 8 bytes for numeric data, 32 max for venue name
		uint8_t buffer[MAX_NAME_LENGTH];
		int readRet = flash_area_read(storageArea, 0, buffer, MAX_NAME_LENGTH);
		if (0 == readRet) {
			// Read OK
			// Check values are not all FF or 00
			size_t nonEmptyCount = 0;
			size_t terminationCharPosition = 0;
			for (size_t pos = 0;pos < MAX_NAME_LENGTH;++pos) {
				if (buffer[pos] != 0 && buffer[pos] != 0xff) {
					++nonEmptyCount;
				}
				if (pos >= 8 && 0 == terminationCharPosition && buffer[pos] == (uint8_t)'\0') {
					// found the first char termination character
					terminationCharPosition = pos;
				}
			}
			if (0 == nonEmptyCount) {
				APP_DBG("Read flash configuration area is empty. Using default configuration.");
			} else {
				APP_DBG("Found configuration");
				country = (uint16_t)(*buffer);
				state = (uint16_t)(*(buffer + 2));
				code = (std::uint32_t)(*(buffer + 4));

				// Read the X, Y, Z position of the beacon (in cm, max 655.35m from origin)
				x = (uint16_t)(*(buffer + 8));
				y = (uint16_t)(*(buffer + 10));
				z = (uint16_t)(*(buffer + 12));

				if (0 == terminationCharPosition) {
					terminationCharPosition = MAX_NAME_LENGTH;
				}
				size_t strLength = terminationCharPosition - 14;
				char cbuffer[MAX_NAME_LENGTH - 14 + 1];
				cbuffer[strLength] = '\0';
				// Read the title string
				for (size_t strPos = 14;strPos < terminationCharPosition;++strPos) {
					cbuffer[strPos - 14] = (char)(*(buffer + strPos));
				}
				name = std::string(cbuffer);
				APP_DBG("Configuration successfully read from flash storage");
			}
		} else {
			APP_DBG("Error reading flash storage area");
		}
		flash_area_close(storageArea);
	}

	ConcreteExtendedDataV1 extendedData;
	extendedData.addSection(ExtendedDataSegmentCodesV1::TextPremises, name);
	Data xyz;
	xyz.append(x);
	xyz.append(y);
	xyz.append(z);
	extendedData.addSection(ExtendedDataSegmentCodesV1::LocalGridPosition, xyz);

	payload::beacon::ConcreteBeaconPayloadDataSupplierV1 pds(
		country,
		state,
		code,
		extendedData
	);
	
	herald::ble::nordic_uart::NordicUartSensorDelegate nus(ctx);

	// this is unusual, but required. Really we should log activity to serial BLE or similar
	DummyDelegate appDelegate;
	SensorDelegateSet sensorDelegates(appDelegate, nus);
	
	ConcreteBLESensor ble(ctx, ctx.getBluetoothStateManager(), pds, sensorDelegates);
	SensorArray sa(ctx,pds,ble);

	// Start array (and thus start advertising)
	sa.start();

	std::uint64_t iter = 0;
	// APP_DBG("got iter!");
	// k_sleep(K_SECONDS(2));
	Date last;
	// APP_DBG("got last!");
	// k_sleep(K_SECONDS(2));
	int delay = 250; // KEEP THIS SMALL!!! This is how often we check to see if anything needs to happen over a connection.
	
	APP_DBG("Entering herald iteration loop");
	k_sleep(K_SECONDS(2));
	while (1) {
		k_sleep(K_MSEC(delay)); 
		Date now;
		if (iter > 40 /* && iter < 44 */ ) { // some delay to allow us to see advertising output
			// You could only do first 3 iterations so we can see the older log messages without continually scrolling through log messages
			APP_DBG("Calling Sensor Array iteration");
			// k_sleep(K_SECONDS(2));
			sa.iteration(now - last);
		}
		
		if (0 == iter % (5000 / delay)) {
			APP_DBG("herald thread still running. Iteration: %lld", iter);
			// runner.run(Date()); // Note: You may want to do this less or more regularly depending on your requirements
			APP_ERR("Memory pages free in Data Arena: %d", herald::datatype::Data::getArena().pagesFree());

			// Send routine message - just our node name and iteration tick for now
			// TODO make this a better status message
			Data toSend;
			toSend.append(extendedData.payload());
			toSend.append(iter);
			ble.queueMessageForSending(toSend,RSSI(-99));
		}

		last = now;
		++iter;
	}
}


int main(void)
{
	// The below LED device lines have changed since at least Zephyr 3.4.0
	if (!gpio_is_ready_dt(&led)) {
		return 1;
	}

	int ret = gpio_pin_configure_dt(&led, GPIO_OUTPUT_ACTIVE);
	if (ret < 0) {
		return 1;
	}

	APP_DBG("Logging test");

	// Start herald entry on a new thread in case of errors, or needing to do something on the main thread
	[[maybe_unused]]
	k_tid_t herald_pid = k_thread_create(&herald_thread, herald_stack, stackMaxSize,
			(k_thread_entry_t)herald_entry, NULL, NULL, NULL,
			-1, K_USER,
			K_NO_WAIT);

	// herald_entry();
	// NOTE Above only works if CONFIG_MAIN_STACK_SIZE=2048 is set in prj.conf

	/* Implement notification. At the moment there is no suitable way
	 * of starting delayed work so we do it here
	 */
	while (1) {
		k_sleep(K_SECONDS(2));
		
		ret = gpio_pin_toggle_dt(&led);
		if (ret < 0) {
			return 1;
		}

		APP_DBG("main thread still running");

		// TODO Add logic here to detect failure in Herald thread, and restart to resume as necessary
	}

	return 0;
};
```

## include/herald_handler.h
```c
/*
 * Copyright 2022 Herald Project Contributors
 * SPDX-License-Identifier: Apache-2.0
 */

/**
 * @file Provides application-level coordination for the Herald Bluetooth 
 * LE and Herald Presence Server functionality
 */

#ifndef HERALD_HANDLER_H__
#define HERALD_HANDLER_H__

#ifdef __cplusplus
extern "C"
{
#endif

/** \brief One off Herald initialisation once beacon is configured **/
void herald_initialise();

void herald_healthcheck();

bool herald_configure();

bool herald_start();

bool herald_stop();

#ifdef __cplusplus
}
#endif

#endif /* HERALD_HANDLER_H__ */
```

## include/no_oob_prov.h
```c
/*
 * Copyright 2022 Herald Project Contributors
 * SPDX-License-Identifier: Apache-2.0
 */

#ifndef NO_OOB_PROV_H__
#define NO_OOB_PROV_H__

#include <bluetooth/mesh.h>

#ifdef __cplusplus
extern "C" {
#endif

// Define callbacks for main module
struct no_oob_prov_cb {
  void (*provisioned)(uint16_t net_idx, uint16_t src);
  void (*reset)();
};

extern const struct no_oob_prov_cb* prov_callbacks;

/** @brief Dummy provisioner with no OOB support
 *
 * @return The provisioning properties to pass to @em bt_mesh_init().
 */
const struct bt_mesh_prov* bt_mesh_no_oob_prov_init(
  const struct no_oob_prov_cb* prov_cbs);

#ifdef __cplusplus
}
#endif

#endif /* NO_OOB_PROV_H__ */
```

## src/herald_handler.cpp
```c
/*
 * Copyright 2020-2022 Herald Project Contributors
 * SPDX-License-Identifier: Apache-2.0
 */

#include "herald_handler.h"

// #include "../../herald/herald.h" // This is convenient, but leads to large
// binaries!
#include "herald/ble/ble_sensor_configuration.h"
#include "herald/ble/zephyr/concrete_ble_receiver.h"
// #include "herald/ble/zephyr/concrete_ble_transmitter.h"
// #include "herald/ble/zephyr/nordic_uart/nordic_uart_sensor_delegate.h"
#include "herald/datatype/date.h"
#include "herald/datatype/immediate_send_data.h"
#include "herald/datatype/location.h"
#include "herald/datatype/payload_data.h"
#include "herald/datatype/proximity.h"
#include "herald/datatype/sensor_state.h"
#include "herald/datatype/sensor_type.h"
#include "herald/datatype/target_identifier.h"
#include "herald/mesh/mesh.h"
#include "herald/mesh/presence.h"
#include "herald/mesh/presence_server.h"
// #include "herald/payload/beacon/beacon_payload_data_supplier.h"
// #include "herald/payload/extended/extended_data.h"
#include "herald/payload/fixed/fixed_payload_data_supplier.h"
#include "herald/sensor.h"
#include "herald/sensor_array.h"
#include "herald/sensor_delegate.h"
#include "herald/zephyr_context.h"

#include <kernel.h>

#include <logging/log.h>
LOG_MODULE_REGISTER(app_herald, CONFIG_APP_LOG_LEVEL);
#define APP_DBG(_msg, ...) LOG_DBG(_msg, ##__VA_ARGS__);
#define APP_INF(_msg, ...) LOG_INF(_msg, ##__VA_ARGS__);
#define APP_ERR(_msg, ...) LOG_ERR(_msg, ##__VA_ARGS__);

struct k_thread herald_thread;
constexpr int stackMaxSize =
#ifdef CONFIG_BT_MAX_CONN
    2048 + (CONFIG_BT_MAX_CONN * 512)
// Was 12288 + (CONFIG_BT_MAX_CONN * 512), but this starved newlibc of HEAP
// (used in handling BLE connections/devices)
#else
    9192
#endif
// Since v2.1 - MEMORY ARENA extra stack reservation - See
// herald/datatype/data.h
#ifdef HERALD_MEMORYARENA_MAX
    + HERALD_MEMORYARENA_MAX
#else
    + 8192
#endif
    ;
K_THREAD_STACK_DEFINE(herald_stack,
                      stackMaxSize);  // Was 9192 for nRF5340 (10 conns), 2048
                                      // for nRF52832 (3 conns)

// When did we last send nearby presence data over mesh (TODO REPLACE THIS)
int lastShared = 0;

using namespace herald::datatype;
using namespace herald::ble;

char* str(const TargetIdentifier& ti) {
  return log_strdup(((std::string)ti).c_str());
}
// struct DummyDelegate{};
class AppLoggingDelegate {
 public:
  AppLoggingDelegate() = default;
  ~AppLoggingDelegate() = default;

  void sensor(SensorType sensor, const TargetIdentifier& didDetect) {
    // LOG_DBG("sensor didDetect");
    APP_DBG("sensor didDetect: %s",
            str(didDetect));  // May want to disable this - logs A LOT of info
  }

  /// Read payload data from target, e.g. encrypted device identifier from BLE
  /// peripheral after successful connection.
  void sensor(SensorType sensor, const PayloadData& didRead,
              const TargetIdentifier& fromTarget) {
    // LOG_DBG("sensor didRead");
    APP_DBG("sensor didRead: %s with payload: %s", str(fromTarget),
            log_strdup(didRead.hexEncodedString().c_str()));
  }

  /// Receive written immediate send data from target, e.g. important timing
  /// signal.
  void sensor(SensorType sensor, const ImmediateSendData& didReceive,
              const TargetIdentifier& fromTarget) {
    // LOG_DBG("sensor didReceive");
    APP_DBG("sensor didReceive: %s with immediate send data: %s",
            str(fromTarget), log_strdup(didReceive.hexEncodedString().c_str()));
  }

  /// Read payload data of other targets recently acquired by a target, e.g.
  /// Android peripheral sharing payload data acquired from nearby iOS
  /// peripherals.
  void sensor(SensorType sensor, const std::vector<PayloadData>& didShare,
              const TargetIdentifier& fromTarget) {
    APP_DBG("sensor didShare");
    // LOG_DBG("sensor didShare: %s", str(fromTarget) );
    // for (auto& p : didShare) {
    //   LOG_DBG(" - %s", log_strdup(p.hexEncodedString().c_str()));
    // }
  }

  /// Measure proximity to target, e.g. a sample of RSSI values from BLE
  /// peripheral.
  void sensor(SensorType sensor, const Proximity& didMeasure,
              const TargetIdentifier& fromTarget) {
    APP_DBG(
        "didMeasure: %s, fromTarget: %s",
        log_strdup(didMeasure.description().c_str()),
        log_strdup(
            ((std::string)BLEMacAddress(fromTarget.underlyingData())).c_str()));
    // LOG_DBG("sensor didMeasure: %s with proximity: %d", str(fromTarget),
    // didMeasure.value);

    // Now send a did detect message over mesh
    // Note: This frequency is managed by BLESensorConfiguration
    // For now, delay so many seconds
    int now = 0.001 * k_uptime_get();
    if (lastShared + 5 < now) {
      lastShared = now;
      uint8_t seenMac[6] = {0, 1, 2, 3, 4, 5};
    //   const auto& d = fromTarget.underlyingData();
    //   bool ok = d.uint8(0, *seenMac);
    //   ok = d.uint8(1, *(seenMac + 1));
    //   ok = d.uint8(2, *(seenMac + 2));
    //   ok = d.uint8(3, *(seenMac + 3));
    //   ok = d.uint8(4, *(seenMac + 4));
    //   ok = d.uint8(5, *(seenMac + 5));
      // TODO check the above return values
      int res = bt_mesh_herald_presence_share(
          seenMac, -40,
          bt_mesh_model_herald_presence_status::
              BT_MESH_HERALD_PRESENCE_OBSERVED);
      APP_DBG("Presence publishing result: %d", res);
    }
  }

  /// Detection of time spent at location, e.g. at specific restaurant between
  /// 02/06/2020 19:00 and 02/06/2020 21:00
  template <typename LocationT>
  void sensor(SensorType sensor, const Location<LocationT>& didVisit) {
    APP_DBG("sensor didVisit");
  }

  /// Measure proximity to target with payload data. Combines didMeasure and
  /// didRead into a single convenient delegate method
  void sensor(SensorType sensor, const Proximity& didMeasure,
              const TargetIdentifier& fromTarget,
              const PayloadData& withPayload) {
    // ERR so it stands out in the logging!
    APP_ERR(
        "didMeasure=%s, fromTarget=%s, withPayload=%s",
        log_strdup(didMeasure.description().c_str()),
        log_strdup(
            ((std::string)BLEMacAddress(fromTarget.underlyingData())).c_str()),
        log_strdup(withPayload.hexEncodedString().c_str()));
  }

  /// Sensor state update
  void sensor(SensorType sensor, const SensorState& didUpdateState) {
    APP_DBG("sensor didUpdateState");
  }
};

using MYUINT32 = unsigned long;

struct basic_venue {
  std::uint16_t country;
  std::uint16_t state;
  MYUINT32 code;  // C++ linker may balk, confusing uint with unsigned long
  std::string name;
};

static struct basic_venue joesPizza = {
    .country = 826, .state = 4, .code = 12345, .name = "Joe's Pizza"};

static struct basic_venue adamsFishShop = {
    .country = 826, .state = 3, .code = 22334, .name = "Adam's Fish Shop"};

static struct basic_venue maxsFineDining = {
    .country = 832, .state = 1, .code = 55566, .name = "Max's Fine Dining"};

static struct basic_venue erinsStakehouse = {
    .country = 826, .state = 4, .code = 123123, .name = "Erin's Stakehouse"};

// TODO replace the below with sub-venue extended data, with same venue code
static struct basic_venue adamsKitchen = {
    .country = 826, .state = 4, .code = 1234, .name = "Adam's Kitchen"};
static struct basic_venue adamsOffice = {
    .country = 826, .state = 4, .code = 2345, .name = "Adam's Office"};
static struct basic_venue adamsBedroom = {
    .country = 826, .state = 4, .code = 3456, .name = "Adam's Bedroom"};
static struct basic_venue adamsLanding = {
    .country = 826, .state = 4, .code = 5678, .name = "Adam's Landing"};
static struct basic_venue adamsPond = {
    .country = 826, .state = 4, .code = 6789, .name = "Adam's Pond"};
static struct basic_venue adamsLounge = {
    .country = 826, .state = 4, .code = 7890, .name = "Adam's Lounge"};

// struct herald_shared_state {
//   herald::SensorArray* sa;
// };
// static struct herald_shared_state herald_app_state = {
// };

void herald_entry() {
  APP_DBG("Herald entry");
  k_sleep(K_MSEC(2000));  // pause so we have time to see Herald initialisation
                          // log messages. Don't do this in production!
  APP_DBG("Herald setup begins");

  using namespace herald;
  using namespace herald::payload;
//   using namespace herald::payload::beacon;
//   using namespace herald::payload::extended;

  // Create Herald sensor array
  ZephyrContextProvider zcp;
  Context ctx(zcp, zcp.getLoggingSink(), zcp.getBluetoothStateManager());
  // using CT =
  // Context<ZephyrContextProvider,ZephyrLoggingSink,BluetoothStateManager>;

  // Disable receiver / scanning mode - we're just transmitting our value
  BLESensorConfiguration config = ctx.getSensorConfiguration();  // copy ctor
  config.scanningEnabled = true;  // To see other nearby BLE devices
  config.advertisingEnabled = false; // TODO For now, until internal nav created
  ctx.setSensorConfiguration(config);

//   ConcreteExtendedDataV1 extendedData;
//   extendedData.addSection(ExtendedDataSegmentCodesV1::TextPremises,
//                           erinsStakehouse.name);

//   // TODO get this from configuration of the MESH element (Nav beacon model)
//   payload::beacon::ConcreteBeaconPayloadDataSupplierV1 pds(
//       erinsStakehouse.country, erinsStakehouse.state, erinsStakehouse.code,
//       extendedData);

  payload::fixed::ConcreteFixedPayloadDataSupplierV1 pds(0,0,0);
  
  AppLoggingDelegate appDelegate;
  SensorDelegateSet sensorDelegates(appDelegate);

  ConcreteBLESensor ble(ctx, ctx.getBluetoothStateManager(), pds,
                        sensorDelegates);
  SensorArray sa(ctx, pds, ble);

  APP_DBG("Starting sensor array");
  sa.start();

  int iter = 0;
  // APP_DBG("got iter!");
  // k_sleep(K_SECONDS(2));
  Date last;
  // APP_DBG("got last!");
  // k_sleep(K_SECONDS(2));
  int delay = 2500;  // KEEP THIS SMALL!!! This is how often we check to see if
                    // anything needs to happen over a connection.

  APP_DBG("Entering herald iteration loop");
  k_sleep(K_SECONDS(2));
  while (1) {
    k_sleep(K_MSEC(delay));
    Date now;
    if (iter > 4 /* && iter < 44 */) {  // some delay to allow us to see
                                         // advertising output
      // You could only do first 3 iterations so we can see the older log
      // messages without continually scrolling through log messages
      APP_DBG("Calling Sensor Array iteration");
      // k_sleep(K_SECONDS(2));
      sa.iteration(now - last);
    }

    if (0 == iter % (5000 / delay)) {
      APP_DBG("herald thread still running. Iteration: %d", iter);
      // runner.run(Date()); // Note: You may want to do this less or more
      // regularly depending on your requirements
      APP_ERR("Memory pages free in Data Arena: %d",
              herald::datatype::Data::getArena().pagesFree());
    }

    last = now;
    ++iter;
  }
}

/** MARK: HERALD HANDLER PUBLIC HEADER METHODS **/
[[maybe_unused]]
k_tid_t herald_pid;

void herald_initialise() {
  APP_DBG("Herald init called");
  if (herald_pid) return;  // single initialisation only
  APP_DBG("Herald init now occuring");
  herald_pid = k_thread_create(
      &herald_thread, herald_stack, stackMaxSize,
      (k_thread_entry_t)herald_entry, NULL, NULL, NULL, -1, K_USER, K_NO_WAIT);
}

void herald_healthcheck() {
  // TODO implement this
  APP_DBG("Herald healthcheck called");
}

bool herald_configure() {
  // TODO implement this - from mesh configuration
  APP_DBG("Herald configure called");
  return true;
}

bool herald_start() {
  APP_DBG("Herald start called");

  // Start array (and thus start advertising, scanning)
  // herald_shared_state.sa->start();

  return true;
}

bool herald_stop() {
  APP_DBG("Herald stop called");

  // Stop array (and thus stop advertising, scanning)
  // herald_shared_state.sa->stop();

  return true;
}
```

## src/lb_service_handler.c
```c
/*
 * Copyright (c) 2021 Nordic Semiconductor ASA
 *
 * SPDX-License-Identifier: LicenseRef-Nordic-5-Clause
 */

#include <zephyr/types.h>
#include <stddef.h>
#include <sys/printk.h>
#include <sys/byteorder.h>
#include <zephyr.h>
#include <drivers/gpio.h>
#include <soc.h>

#include <bluetooth/bluetooth.h>
#include <bluetooth/hci.h>
#include <bluetooth/conn.h>
#include <bluetooth/uuid.h>
#include <bluetooth/gatt.h>

#include <bluetooth/services/lbs.h>
#include <settings/settings.h>
#include <dk_buttons_and_leds.h>

#if !DT_NODE_EXISTS(DT_ALIAS(sw0))
#error "Unsupported board: sw0 devicetree alias is not defined"
#endif

#if !DT_NODE_EXISTS(DT_ALIAS(led1))
#error "Unsupported board: led1 devicetree alias is not defined"
#endif

#define LBS_LED DK_LED2
#define LBS_BUTTON DK_BTN1_MSK

static const struct bt_data ad[] = {
	BT_DATA_BYTES(BT_DATA_FLAGS, (BT_LE_AD_GENERAL | BT_LE_AD_NO_BREDR)),
	BT_DATA(BT_DATA_NAME_COMPLETE, CONFIG_BT_DEVICE_NAME, (sizeof(CONFIG_BT_DEVICE_NAME) - 1)),
};

static const struct bt_data sd[] = {
	BT_DATA_BYTES(BT_DATA_UUID128_ALL, BT_UUID_LBS_VAL),
};

static bool ble_button_state;

static void connected(struct bt_conn *conn, uint8_t err)
{
	if (err) {
		printk("Connection failed (err %u)\n", err);
		return;
	}

	// TODO fire mesh message with presence observed

	printk("Connected\n");
}

static void disconnected(struct bt_conn *conn, uint8_t reason)
{
	printk("Disconnected (reason %u)\n", reason);

	// TODO fire mesh message with presence vanished
}

static struct bt_conn_cb conn_callbacks = {
	.connected = connected,
	.disconnected = disconnected,
};

static void app_led_cb(bool led_state)
{
	dk_set_led(LBS_LED, led_state);
}

static bool app_button_cb(void)
{
	return ble_button_state;
}

static struct bt_lbs_cb lbs_callbacs = {
	.led_cb = app_led_cb,
	.button_cb = app_button_cb,
};

static void button_changed(uint32_t button_state, uint32_t has_changed)
{
	if (has_changed & LBS_BUTTON) {
		uint32_t user_button_state = button_state & LBS_BUTTON;

		bt_lbs_send_button_state(user_button_state);
		ble_button_state = user_button_state ? true : false;
	}
}

static void lbs_adv_start(void)
{
	int err = bt_le_adv_start(BT_LE_ADV_CONN, ad, ARRAY_SIZE(ad), sd, ARRAY_SIZE(sd));

	if (err) {
		printk("Advertising failed to start (err %d)\n", err);
		return;
	}

	printk("Advertising successfully started\n");
}

static void lbs_init(void)
{
	static struct button_handler button_handler = {
		.cb = button_changed,
	};

	dk_button_handler_add(&button_handler);
	bt_conn_cb_register(&conn_callbacks);

	int err = bt_lbs_init(&lbs_callbacs);

	if (err) {
		printk("Failed to init LBS (err:%d)\n", err);
		return;
	}
}

void lbs_handler_init(void)
{
	/** Initiate and add LBS to the device service list. */
	lbs_init();

	/** Start separate advertiser instance. This will allow two simountanious GATT
	 *  connections to the device, one for Mesh and one for the LBS.
	 */
	lbs_adv_start();
}
```

## src/model_handler.c
```c
/*
 * Copyright 2020-2022 Herald Project Contributors
 * SPDX-License-Identifier: Apache-2.0
 */

#include <bluetooth/bluetooth.h>
#include <bluetooth/mesh/models.h>
#include <dk_buttons_and_leds.h> // TODO remove DK link here
#include "model_handler.h"

#include "herald/mesh/presence.h"
#include "herald/mesh/presence_server.h"

#include "herald_handler.h"

#include <logging/log.h>
LOG_MODULE_REGISTER(meshmodel, CONFIG_APP_LOG_LEVEL);

/* Set up a repeating delayed work to blink the DK's LEDs when attention is
 * requested.
 */
static struct k_work_delayable attention_blink_work;
static bool attention;

static void attention_blink(struct k_work *work)
{
  static int idx;

  if (attention) {
    dk_set_leds(BIT((idx++) % 2));
    k_work_reschedule(&attention_blink_work, K_MSEC(30));
  } else {
    dk_set_leds(DK_NO_LEDS_MSK);
  }
}

static void attention_on(struct bt_mesh_model *mod)
{
  attention = true;
  k_work_reschedule(&attention_blink_work, K_NO_WAIT);
}

static void attention_off(struct bt_mesh_model *mod)
{
  /* Will stop rescheduling blink timer */
  attention = false;
}

static const struct bt_mesh_health_srv_cb health_server_cb = {
  .attn_on = attention_on,
  .attn_off = attention_off,
};

static struct bt_mesh_health_srv health_server = {
  .cb = &health_server_cb,
};

BT_MESH_HEALTH_PUB_DEFINE(health_pub, 0);


// HERALD PRESENCE SERVER CALLBACKS FROM HERE

static void presence_on()
{
  LOG_DBG("Presence On");
  herald_initialise();
  bool configured = herald_configure();
  if (!configured) {
    LOG_DBG("Herald Sensor Array could not be configured");
    return;
  }
  bool started = herald_start();
  if (!started) {
    LOG_DBG("Herald Sensor Array could not be started");
  }
}

static void presence_off()
{
  LOG_DBG("Presence Off");
  herald_stop();
}

const struct bt_mesh_herald_presence_server_onoff_cb presence_cbs = {
  .on = presence_on,
  .off = presence_off,
};

static struct bt_mesh_elem elements[] = {
  BT_MESH_ELEM(
    1,
    BT_MESH_MODEL_LIST(
      BT_MESH_MODEL_CFG_SRV,
      BT_MESH_MODEL_HEALTH_SRV(&health_server, &health_pub),
    ),
    BT_MESH_MODEL_LIST(
    )
  ),
  BT_MESH_HERALD_PRESENCE_ELEM(2),
};

static const struct bt_mesh_comp comp = {
  .cid = BT_MESH_LINUX_FOUNDATION_VENDOR_COMPANY_ID,
  .elem = elements,
  .elem_count = ARRAY_SIZE(elements)
};

const struct bt_mesh_comp *model_handler_init(void)
{
  k_work_init_delayable(&attention_blink_work, attention_blink);
  bt_mesh_herald_presence_register_callbacks(&presence_cbs);

  return &comp;
}
```

## src/no_oob_prov.c
```c
/*
 * Copyright 2022 Herald Project Contributors
 * SPDX-License-Identifier: Apache-2.0
 */

#include "no_oob_prov.h"

#include <bluetooth/mesh.h>

#include <drivers/hwinfo.h>

#include <logging/log.h>

LOG_MODULE_REGISTER(no_oob_bt_mesh_prov, CONFIG_APP_LOG_LEVEL);

static struct k_work_delayable oob_work;

// Storage location of extern const struct defined in no_oob_prov.h
const struct no_oob_prov_cb* prov_callbacks;

static void oob_timer_handler(struct k_work* work) {
  // TODO do something
}

static void prov_complete(uint16_t net_idx, uint16_t src) {
  LOG_DBG("Provisioning complete. Address: 0x%04x\n", src);
  if (prov_callbacks && prov_callbacks->provisioned) {
    prov_callbacks->provisioned(net_idx, src);
  }
}

static void prov_reset(void) {
  if (prov_callbacks && prov_callbacks->reset) {
    prov_callbacks->reset();
  }
  bt_mesh_prov_enable(BT_MESH_PROV_ADV | BT_MESH_PROV_GATT);
}

static uint8_t dev_uuid[16];

static const struct bt_mesh_prov prov = {
    .uuid = dev_uuid,
    .output_actions = (0), // No OOB
    .complete = prov_complete,
    .reset = prov_reset,
};

const struct bt_mesh_prov* bt_mesh_no_oob_prov_init(
    const struct no_oob_prov_cb* cbs) {
  prov_callbacks = cbs;
  /* Generate an RFC-4122 version 4 compliant UUID.
    * Format:
    *
    * 0                   1                   2                   3
    * 0 1 2 3 4 5 6 7 8 9 0 1 2 3 4 5 6 7 8 9 0 1 2 3 4 5 6 7 8 9 0 1
    * +-+-+-+-+-+-+-+-+-+-+-+-+-+-+-+-+-+-+-+-+-+-+-+-+-+-+-+-+-+-+-+-+
    * |                          time_low                             |
    * +-+-+-+-+-+-+-+-+-+-+-+-+-+-+-+-+-+-+-+-+-+-+-+-+-+-+-+-+-+-+-+-+
    * |       time_mid                |         time_hi_and_version   |
    * +-+-+-+-+-+-+-+-+-+-+-+-+-+-+-+-+-+-+-+-+-+-+-+-+-+-+-+-+-+-+-+-+
    * |clk_seq_hi_res |  clk_seq_low  |         node (0-1)            |
    * +-+-+-+-+-+-+-+-+-+-+-+-+-+-+-+-+-+-+-+-+-+-+-+-+-+-+-+-+-+-+-+-+
    * |                         node (2-5)                            |
    * +-+-+-+-+-+-+-+-+-+-+-+-+-+-+-+-+-+-+-+-+-+-+-+-+-+-+-+-+-+-+-+-+
    *
    * Where the 4 most significant bits of time_hi_and_version shall be
    * 0b0010 and the 2 most significant bits of clk_seq_hi_res shall be
    * 0b10. The remaining fields have no required values, and are fetched
    * from the HW info device ID. The fields are encoded in big endian
    * format.
    *
    * https://tools.ietf.org/html/rfc4122
    */
  hwinfo_get_device_id(dev_uuid, sizeof(dev_uuid));
  dev_uuid[6] = (dev_uuid[6] & BIT_MASK(4)) | BIT(6);
  dev_uuid[8] = (dev_uuid[8] & BIT_MASK(6)) | BIT(7);

  k_work_init_delayable(&oob_work, oob_timer_handler);

  return &prov;
}
```
